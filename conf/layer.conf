## conf/layer.conf
```bitbake
# We have a conf and classes directory, add to BBPATH
BBPATH .= ":${LAYERDIR}"

# We have recipes-* directories, add to BBFILES
BBFILES += "${LAYERDIR}/recipes-*/*/*.bb \
	    ${LAYERDIR}/recipes-*/*/*.bbappend"

BBFILE_COLLECTIONS += "meta-out4"
BBFILE_PATTERN_meta-out4 = "^${LAYERDIR}/"
BBFILE_PRIORITY_meta-out4 = "6"

LAYERDEPENDS_meta-out4 = "core"
LAYERSERIES_COMPAT_meta-out4 = "zeus dunfell"
```

## conf/machine/ev-imx280-nano-x-mb.conf
```bitbake
# conf/machine/ev-imx280-nano-x-mb.conf
# Copyright (C) 2021 Oleh Kravchenko <oleg@kaa.org.ua>
# Released under the MIT license (see LICENSE for the terms)

require conf/machine/include/tune-cortexa7.inc

SERIAL_CONSOLES ?= "115200;ttymxc0"
SERIAL_CONSOLES_CHECK = "${SERIAL_CONSOLES}"

KERNEL_IMAGETYPE = "zImage"
WKS_FILE = "o4-imx6ull-nano.wks"
WIC_CREATE_EXTRA_ARGS = "--no-fstab-update"

MACHINE_FEATURES = "serial usbgadget usbhost vfat"

PREFERRED_PROVIDER_virtual/kernel ?= "linux-out4"

PREFERRED_PROVIDER_virtual/bootloader ?= "u-boot-out4"
UBOOT_MACHINE = "ev-imx280-nano-x-mb_defconfig"
UBOOT_INITIAL_ENV = ""

MACHINE_ESSENTIAL_EXTRA_RDEPENDS += " \
	${PREFERRED_PROVIDER_virtual/bootloader} \
	kernel-modules \
	u-boot-tools \
"

IMAGE_CLASSES += "image_types_uuu"
```

## conf/machine/o4-imx6ull-nano.conf
```bitbake
# conf/machine/o4-imx6ull-nano.conf
# Copyright (C) 2021 Oleh Kravchenko <oleg@kaa.org.ua>
# Released under the MIT license (see LICENSE for the terms)

#@TYPE: Machine
#@NAME: o4-imx6ull-nano
#@DESCRIPTION: Motherboard for O4-iMX6ULL-NANO with reset button, TTL 3.3V UART, MicroSD, 2xUSB, 2xEthernet 10/100, 2xRGB LEDs, CAN, RS485, power 6-15V, and GPIO.

require conf/machine/include/tune-cortexa7.inc

SERIAL_CONSOLES ?= "115200;ttymxc0"
SERIAL_CONSOLES_CHECK = "${SERIAL_CONSOLES}"

KERNEL_IMAGETYPE = "zImage"
WKS_FILE = "o4-imx6ull-nano.wks"
WIC_CREATE_EXTRA_ARGS = "--no-fstab-update"

MACHINE_FEATURES = "serial usbhost vfat"

PREFERRED_PROVIDER_virtual/kernel ?= "linux-out4"

PREFERRED_PROVIDER_virtual/bootloader ?= "u-boot-out4"
UBOOT_MACHINE = "o4-imx6ull-nano_defconfig"
UBOOT_INITIAL_ENV = ""

MACHINE_ESSENTIAL_EXTRA_RDEPENDS += " \
	${PREFERRED_PROVIDER_virtual/bootloader} \
	kernel-modules \
	u-boot-tools \
"

IMAGE_CLASSES += "image_types_uuu"
```

## wic/o4-imx6ull-nano.wks
```
# short-description: Create eMMC image for O4-iMX6ULL-NANO
# long-description: Create a partitioned eMMC image for O4-iMX6ULL-NANO reference hardware.
part / --source rootfs --ondisk mmcblk0 --fstype=ext4 --label ROOT --part-name ROOT --part-type 69DAD710-2CE4-4E3C-B16C-21A1D49ABED3 --align 1024 --offset 1024 --mkfs-extraopts '-I 256'
bootloader --ptable gpt
```
